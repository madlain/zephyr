/*
 * Copyright (c) 2018 Madani Lainani
 *
 * SPDX-License-Identifier: Apache-2.0
 */

#include <mem.h>
#include <atmel/sam4l.dtsi>

/ {
	sram0: memory@20000000 {
		device_type = "memory";
		compatible = "mmio-sram";
		reg = <0x20000000 DT_SIZE_K(32)>;
	};

	flash0: flash@0 {
		compatible = "soc-nv-flash";
		label = "FLASH_0";
		reg = <0x0 DT_SIZE_K(256)>;
	};
};
