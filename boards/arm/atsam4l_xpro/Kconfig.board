## boards/arm/atsam4l_xpro/Kconfig.board
```kconfig
# Kconfig - Atmel SAM4L Xplained Pro configuration
#
# Copyright (c) 2018 Madani Lainani.
# SPDX-License-Identifier: Apache-2.0

config BOARD_ATSAM4L_XPRO
	bool "Atmel SAM4L Xplained Pro"
	depends on SOC_PART_NUMBER_SAM4LC4C
```

## boards/arm/atsam4l_xpro/Kconfig.defconfig
```kconfig
# Kconfig - Atmel SAM4L Xplained Pro configuration
#
# Copyright (c) 2018 Madani Lainani.
# SPDX-License-Identifier: Apache-2.0

if BOARD_ATSAM4L_XPRO

config BOARD
	default "atsam4l_xpro"

config ASF
	bool

endif # BOARD_ATSAM4L_XPRO
```

## boards/arm/atsam4l_xpro/atsam4l_xpro_defconfig
```kconfig
# Copyright (c) 2018 Madani Lainani.
# SPDX-License-Identifier: Apache-2.0

CONFIG_ARM=y
CONFIG_SOC_FAMILY_SAM=y
CONFIG_SOC_SERIES_SAM4L4=y
CONFIG_SOC_PART_NUMBER_SAM4LC4C=y
CONFIG_BOARD_ATSAM4L_XPRO=y
CONFIG_CORTEX_M_SYSTICK=y
CONFIG_WATCHDOG=n
CONFIG_CONSOLE=y
CONFIG_UART_CONSOLE=y
CONFIG_SERIAL=y
CONFIG_USART_SAM=y
```

## drivers/gpio/Kconfig.sam4l
```kconfig
# Kconfig.sam4l - Atmel SAM4L GPIO controller configuration options
#
# Copyright (c) 2018 Madani Lainani
# SPDX-License-Identifier: Apache-2.0

menuconfig GPIO_SAM4L
	bool "Atmel SAM4L GPIO controller driver"
	depends on GPIO && SOC_FAMILY_SAM
	select HAS_DTS_GPIO
	help
	  Enable support for Atmel SAM4L GPIO controller.
```

## drivers/serial/Kconfig.sam4l
```kconfig
# Kconfig.sam4l - Atmel SAM4L USART configuration options
#
# Copyright (c) 2019 Madani Lainani
# SPDX-License-Identifier: Apache-2.0

config USART_SAM4L
	bool "Atmel SAM4L USART driver"
	depends on SOC_FAMILY_SAM && SOC_SERIES_SAM4L4
	select SERIAL_HAS_DRIVER
	# select SERIAL_SUPPORT_INTERRUPT
	help
	  Enable support for Atmel SAM4L USART
```

## soc/arm/atmel_sam/sam4l4/Kconfig.defconfig.series
```kconfig
# Kconfig - Atmel SAM4L4 MCU series configuration options
#
# Copyright (c) 2018 Madani Lainani
# SPDX-License-Identifier: Apache-2.0

if SOC_SERIES_SAM4L4

config SOC_SERIES
	string
	default "sam4l4"

config SOC_PART_NUMBER
	string
	default "sam4lc4c" if SOC_PART_NUMBER_SAM4LC4C

config NUM_IRQS
	int
	default 80

config SYS_CLOCK_HW_CYCLES_PER_SEC
	int
	default 48000000

endif # SOC_SERIES_SAM4L4
```

## soc/arm/atmel_sam/sam4l4/Kconfig.series
```kconfig
# Kconfig - Atmel SAM4L4 MCU series
#
# Copyright (c) 2018 Madani Lainani
# SPDX-License-Identifier: Apache-2.0

config SOC_SERIES_SAM4L4
	bool "Atmel SAM4L4 MCU"
	select CPU_CORTEX_M
	select CPU_CORTEX_M4
	select SOC_FAMILY_SAM
	select SYS_POWER_LOW_POWER_STATE_SUPPORTED
	select CPU_HAS_SYSTICK
	select ASF
	help
	  Enable support for Atmel SAM4L4 Cortex-M4 microcontrollers.
```

## soc/arm/atmel_sam/sam4l4/Kconfig.soc
```kconfig
# Kconfig - Atmel SAM4L4 MCU series
#
# Copyright (c) 2018 Madani Lainani
# SPDX-License-Identifier: Apache-2.0

choice
prompt "Atmel SAM4L4 MCU Selection"
depends on SOC_SERIES_SAM4L4

config SOC_PART_NUMBER_SAM4LC4C
	bool "SAM4LC4C"

endchoice
```
